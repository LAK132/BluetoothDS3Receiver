## ESP32/sdkconfig.defaults
```kconfig
CONFIG_AUTOSTART_ARDUINO=n

CONFIG_ARDUINO_SELECTIVE_COMPILATION=y
CONFIG_ARDUINO_SELECTIVE_ArduinoOTA=
CONFIG_ARDUINO_SELECTIVE_AsyncUDP=
CONFIG_ARDUINO_SELECTIVE_AzureIoT=
CONFIG_ARDUINO_SELECTIVE_BLE=
CONFIG_ARDUINO_SELECTIVE_BluetoothSerial=
CONFIG_ARDUINO_SELECTIVE_DNSServer=
CONFIG_ARDUINO_SELECTIVE_EEPROM=
CONFIG_ARDUINO_SELECTIVE_ESP32=
CONFIG_ARDUINO_SELECTIVE_ESPmDNS=
CONFIG_ARDUINO_SELECTIVE_FFat=
CONFIG_ARDUINO_SELECTIVE_FS=y
CONFIG_ARDUINO_SELECTIVE_HTTPClient=
CONFIG_ARDUINO_SELECTIVE_NetBIOS=
CONFIG_ARDUINO_SELECTIVE_Preferences=
CONFIG_ARDUINO_SELECTIVE_SD=
CONFIG_ARDUINO_SELECTIVE_SD_MMC=
CONFIG_ARDUINO_SELECTIVE_SimpleBLE=
CONFIG_ARDUINO_SELECTIVE_SPI=y
CONFIG_ARDUINO_SELECTIVE_SPIFFS=
CONFIG_ARDUINO_SELECTIVE_Ticker=
CONFIG_ARDUINO_SELECTIVE_Update=
CONFIG_ARDUINO_SELECTIVE_WebServer=
CONFIG_ARDUINO_SELECTIVE_WiFi=y
CONFIG_ARDUINO_SELECTIVE_WiFiClientSecure=
CONFIG_ARDUINO_SELECTIVE_Wire=

CONFIG_ESPTOOLPY_FLASHSIZE_4MB=y
CONFIG_ESPTOOLPY_FLASHSIZE="4MB"

CONFIG_BT_ENABLED=y
CONFIG_BTDM_CONTROLLER_MODE_BR_EDR_ONLY=y

CONFIG_BLUEDROID_ENABLED=y
CONFIG_CLASSIC_BT_ENABLED=y
CONFIG_BT_SPP_ENABLED=y
```
